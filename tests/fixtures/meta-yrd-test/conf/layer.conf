## tests/fixtures/meta-yrd-test/conf/layer.conf
```bitbake
BBPATH .= ":${LAYERDIR}"
BBFILES += "${LAYERDIR}/recipes-*/*/*.bb ${LAYERDIR}/recipes-*/*/*.bbappend"
BBFILE_COLLECTIONS += "yrd-test"
BBFILE_PATTERN_yrd-test = "^${LAYERDIR}/"
BBFILE_PRIORITY_yrd-test = "1"
LAYERSERIES_COMPAT_yrd-test = "kirkstone langdale mickledore nanbield scarthgap styhead walnascar whinlatter"
```
